## config/west.yml
```yaml
manifest:
  remotes:
    - name: zmkfirmware
      url-base: https://github.com/zmkfirmware
    - name: keyboardio
      url-base: https://github.com/keyboardio
    - name: prospector
      url-base: https://github.com/t-ogura
    # Additional modules containing boards/shields/custom code can be listed here as well
    # See https://docs.zephyrproject.org/3.2.0/develop/west/manifest.html#projects
  projects:
    - name: zmk
      remote: zmkfirmware
      revision: main
      import: app/west.yml
    - name: keyboardio-preonic-zmk-module
      remote: keyboardio
      revision: main
    - name: prospector-zmk-module
      remote: prospector
      revision: v2.0.0  # Use specific version tag
      path: modules/prospector-zmk-module
  self:
    path: config
```
